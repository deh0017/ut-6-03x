// spaceInvaders.c
// Runs on LM4F120/TM4C123
// Chris Last
#include "tm4c123gh6pm.h"
#include "nokia5110.h"
#include "random.h"
#include "TExaS.h"

// spaceInvaders.c
// Runs on LM4F120/TM4C123
// Jonathan Valvano and Daniel Valvano
// This is a starter project for the edX Lab 15
// In order for other students to play your game
// 1) You must leave the hardware configuration as defined
// 2) You must not add/remove any files from the project
// 3) You must add your code only this this C file
// I.e., if you wish to use code from sprite.c or sound.c, move that code in this file
// 4) It must compile with the 32k limit of the free Keil

// April 10, 2014
// http://www.spaceinvaders.de/
// sounds at http://www.classicgaming.cc/classics/spaceinvaders/sounds.php
// http://www.classicgaming.cc/classics/spaceinvaders/playguide.php
/* This example accompanies the books
   "Embedded Systems: Real Time Interfacing to Arm Cortex M Microcontrollers",
   ISBN: 978-1463590154, Jonathan Valvano, copyright (c) 2013

   "Embedded Systems: Introduction to Arm Cortex M Microcontrollers",
   ISBN: 978-1469998749, Jonathan Valvano, copyright (c) 2013

 Copyright 2014 by Jonathan W. Valvano, valvano@mail.utexas.edu
    You may use, edit, run or distribute this file
    as long as the above copyright notice remains
 THIS SOFTWARE IS PROVIDED "AS IS".  NO WARRANTIES, WHETHER EXPRESS, IMPLIED
 OR STATUTORY, INCLUDING, BUT NOT LIMITED TO, IMPLIED WARRANTIES OF
 MERCHANTABILITY AND FITNESS FOR A PARTICULAR PURPOSE APPLY TO THIS SOFTWARE.
 VALVANO SHALL NOT, IN ANY CIRCUMSTANCES, BE LIABLE FOR SPECIAL, INCIDENTAL,
 OR CONSEQUENTIAL DAMAGES, FOR ANY REASON WHATSOEVER.
 For more information about my classes, my research, and my books, see
 http://users.ece.utexas.edu/~valvano/
 */
 /* Hardware Info
// ******* Required Hardware I/O connections*******************
// Slide pot pin 1 connected to ground
// Slide pot pin 2 connected to PE2/AIN1
// Slide pot pin 3 connected to +3.3V
// fire button connected to PE0
// special weapon fire button connected to PE1
// 8*R resistor DAC bit 0 on PB0 (least significant bit)
// 4*R resistor DAC bit 1 on PB1
// 2*R resistor DAC bit 2 on PB2
// 1*R resistor DAC bit 3 on PB3 (most significant bit)
// LED on PB4
// LED on PB5

// Red SparkFun Nokia 5110 (LCD-10168)
// -----------------------------------
// Signal        (Nokia 5110) LaunchPad pin
// 3.3V          (VCC, pin 1) power
// Ground        (GND, pin 2) ground
// SSI0Fss       (SCE, pin 3) connected to PA3
// Reset         (RST, pin 4) connected to PA7
// Data/Command  (D/C, pin 5) connected to PA6
// SSI0Tx        (DN,  pin 6) connected to PA5
// SSI0Clk       (SCLK, pin 7) connected to PA2
// back light    (LED, pin 8) not connected, consists of 4 white LEDs which draw ~80mA total
*/


/*************** GENERAL PURPOSE DEFINES ************/
#define CLOCK_SPEED 80000000L
#define TRUE  (1)
#define FALSE (0)
#define ON    (1)
#define OFF   (0)
#define LEFT (-1) // x-pos offset for left movement
#define RIGHT (1) // x-pos offset for right movement
#define UP   (-1) // y-pos offset for up movement
#define DOWN  (1) // y-pos offset for down movement
#define BIT(X) (1L<<(X)) // single bit set
#define PCTL(X) (7L<<(X*3)) // three bits set

// General and intialisation functions
void DisableInterrupts(void); // Disable interrupts
void EnableInterrupts(void);  // Enable interrupts
void WaitForInterrupt(void);  // Wait for interrupts
void Timer2_Init(unsigned long period);
void Delay100ms(unsigned long count); // time delay in 0.1 seconds
void init(void);

/************************************ GAME DATA *******************************************/

#define ALIEN_COLS 5 // number of aliens in each row
#define ALIEN_ROWS 3 // number of aliens in each column
#define BUNKERS 2    // number of bunkers
#define PMISSILES 10 // number of concurrent missiles a player can fire
#define AMISSILES 4  // number of concurrent missiles aliens can fire
#define MAX_SCORE_DIGITS 6

// Use these parameters to adjust the chance of firing a missile
#define RAND_MAX 255            // Maximum value returned by rand function
#define RAND_BASE_REDUCTION 220 // MAX - REDUCTION = base chance for alien to fire a missile (255 - 220 = 35 = ~14%)
#define RAND_MISSILE_WEIGHT 5   // reduced further by missiles already fired (5 * 3 = 15 = ~6%)
#define RAND_ALIEN_WEIGHT 2     // reduced further by existing aliens as more can randomly fire (15 * 2 = 30 = ~12%)

#define MAX_POWER 4

// Sprites
typedef struct Sprite{
	int x_pos;
	int y_pos;
	int width;
	int height;
	int exists;
	int bitmapn;
	int exploding_at;
	int score;
	const unsigned char* bitmap[4];
} Sprite;

Sprite score_digits[MAX_SCORE_DIGITS];
Sprite player;
Sprite powerbar;
Sprite hearts;
Sprite aliens[ALIEN_COLS][ALIEN_ROWS];
Sprite mothership;
Sprite bunkers[BUNKERS];
Sprite player_missiles[PMISSILES];
Sprite alien_missiles[AMISSILES];
Sprite* sprite_list[MAX_SCORE_DIGITS+1+1+1+(ALIEN_COLS*ALIEN_ROWS)+1+BUNKERS+PMISSILES+AMISSILES];
const int nsprites = (sizeof(sprite_list)/sizeof(sprite_list[0]));

// Global game parameters
int AlienSpeed;
int AlienInitialSpeed = 16;
int alien_direction;
int score;
int level=1;
int lives;
int power_up = 0;
int power_level = MAX_POWER;

// Game functions
void init_sprites(void);
void draw_board(void);
void reset_board(void);
void move_alien_missiles(void);
void move_player_missiles(void);
void move_player(void);
void move_mothership(void);
void move_sprites(void);
void explode_alien(Sprite *alien);
void explode_player(void);
void update_score(int value);
void damage_bunker(Sprite *bunker);
void destroy(Sprite *s);
void show_level(void);
void game_over(void);
int sprite_collision(Sprite *s1, Sprite *s2);

/*********************************** GRAPHICS ******************************************/

#define BMP_WIDTH 18
#define BMP_HEIGHT 22
#define SCREENH 48
#define SCREENW 84

const unsigned char Bunker0[] = { 0x42, 0x4D, 0xB2, 0x00, 0x00, 0x00, 0x00, 0x00, 0x00, 0x00, 0x76, 0x00, 0x00,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 0x00, 0xFF};
const unsigned char Bunker1[] = { 0x42, 0x4D, 0xB2, 0x00, 0x00, 0x00, 0x00, 0x00, 0x00, 0x00, 0x76, 0x00, 0x00,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 0x00, 0xFF};
const unsigned char Bunker2[] = {	0x42, 0x4D, 0xB2, 0x00, 0x00, 0x00, 0x00, 0x00, 0x00, 0x00, 0x76, 0x00, 0x00,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 0x00, 0xFF};
const unsigned char Marqueecjl[] = { 0x42, 0x4d, 0xb6, 0x08, 0x00, 0x00, 0x00, 0x00, 0x00, 0x00, 0x76, 0x00, 0x00,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 0xff,
0x0f, 0xf0, 0x00, 0x0f, 0xff, 0xf0, 0x0f, 0xff, 0x00, 0x0f, 0xff, 0x00,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 0x00
, 0x00, 0x00, 0x00, 0x0f, 0xff, 0x00, 0xff, 0xff, 0xff, 0xff, 0xf0, 0x00,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 0xf0,
0x00, 0xf0, 0x00, 0x0f, 0x00, 0xf0, 0x00, 0xf0, 0x00, 0x00, 0x0f, 0xff,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 0x00, 0xFF};

const unsigned char Heart0cjl[] = { 0x42, 0x4d, 0xbe, 0x00, 0x00, 0x00, 0x00, 0x00, 0x00, 0x00, 0x76, 0x00, 0x00,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 0x00, 0xFF};
const unsigned char Heart1cjl[] = { 0x42, 0x4d, 0xbe, 0x00, 0x00, 0x00, 0x00, 0x00, 0x00, 0x00, 0x76, 0x00, 0x00,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 0x00, 0xFF};
const unsigned char Heart2cjl[] = { 0x42, 0x4d, 0xbe, 0x00, 0x00, 0x00, 0x00, 0x00, 0x00, 0x00, 0x76, 0x00, 0x00,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 0x00, 0xFF};
const unsigned char Heart3cjl[] = { 0x42, 0x4d, 0xbe, 0x00, 0x00, 0x00, 0x00, 0x00, 0x00, 0x00, 0x76, 0x00, 0x00,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 0x00, 0xFF};
const unsigned char PlayerExplosion0cjl[] = {	0x42, 0x4d, 0xbe, 0x00, 0x00, 0x00, 0x00, 0x00, 0x00, 0x00, 0x76, 0x00, 0x00,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 0x00, 0xFF};
const unsigned char PlayerExplosion1cjl[] = { 0x42, 0x4d, 0xbe, 0x00, 0x00, 0x00, 0x00, 0x00, 0x00, 0x00, 0x76, 0x00, 0x00,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 0x00, 0xFF};
const unsigned char SmallExplosion0cjl[] = { 0x42, 0x4d, 0xb6, 0x00, 0x00, 0x00, 0x00, 0x00, 0x00, 0x00, 0x76, 0x00, 0x00,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 0x00, 0xFF};
const unsigned char SmallExplosion1cjl[] = { 0x42, 0x4d, 0xb6, 0x00, 0x00, 0x00, 0x00, 0x00, 0x00, 0x00, 0x76, 0x00, 0x00,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 0x00, 0xFF};
const unsigned char SmallEnemyBonuscjl[] ={ 0x42, 0x4D, 0xAE, 0x00, 0x00, 0x00, 0x00, 0x00, 0x00, 0x00, 0x76, 0x00, 0x00,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 0xFF,};
const unsigned char SmallEnemy30pointBcjl[] ={ 0x42, 0x4D, 0xB6, 0x00, 0x00, 0x00, 0x00, 0x00, 0x00, 0x00, 0x76, 0x00, 0x00,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 0xFF,};
const unsigned char SmallEnemy30pointAcjl[] ={ 0x42, 0x4D, 0xB6, 0x00, 0x00, 0x00, 0x00, 0x00, 0x00, 0x00, 0x76, 0x00, 0x00,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 0xFF,};
const unsigned char SmallEnemy20pointBcjl[] ={ 0x42, 0x4D, 0xB6, 0x00, 0x00, 0x00, 0x00, 0x00, 0x00, 0x00, 0x76, 0x00, 0x00,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 0xFF,};
const unsigned char SmallEnemy20pointAcjl[] ={ 0x42, 0x4D, 0xB6, 0x00, 0x00, 0x00, 0x00, 0x00, 0x00, 0x00, 0x76, 0x00, 0x00,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 0xFF,};
const unsigned char SmallEnemy10pointBcjl[] ={ 0x42, 0x4D, 0xB6, 0x00, 0x00, 0x00, 0x00, 0x00, 0x00, 0x00, 0x76, 0x00, 0x00,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 0xFF,};
const unsigned char SmallEnemy10pointAcjl[] ={ 0x42, 0x4D, 0xAE, 0x00, 0x00, 0x00, 0x00, 0x00, 0x00, 0x00, 0x76, 0x00, 0x00,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 0xFF,};
const unsigned char PlayerShip0cjl[] = { 0x42, 0x4d, 0xae, 0x00, 0x00, 0x00, 0x00, 0x00, 0x00, 0x00, 0x76, 0x00, 0x00,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 0x00, 0xFF};
const unsigned char powerbar1cjl[] = { 0x42, 0x4d, 0x8e, 0x00, 0x00, 0x00, 0x00, 0x00, 0x00, 0x00, 0x76, 0x00, 0x00,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 0x00, 0xFF};
const unsigned char powerbar2cjl[] = { 0x42, 0x4d, 0x8e, 0x00, 0x00, 0x00, 0x00, 0x00, 0x00, 0x00, 0x76, 0x00, 0x00,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 0x00, 0xFF};
const unsigned char powerbar3cjl[] = { 0x42, 0x4d, 0x8e, 0x00, 0x00, 0x00, 0x00, 0x00, 0x00, 0x00, 0x76, 0x00, 0x00,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 0x00, 0xFF};
const unsigned char powerbar4cjl[] = { 0x42, 0x4d, 0x8e, 0x00, 0x00, 0x00, 0x00, 0x00, 0x00, 0x00, 0x76, 0x00, 0x00,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 0x00, 0xFF};
const unsigned char Missile1cjl[] ={ 0x42, 0x4D, 0x96, 0x00, 0x00, 0x00, 0x00, 0x00, 0x00, 0x00, 0x76, 0x00, 0x00,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 0xFF,};
const unsigned char Missile0cjl[] ={ 0x42, 0x4D, 0x92, 0x00, 0x00, 0x00, 0x00, 0x00, 0x00, 0x00, 0x76, 0x00, 0x00,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0xFF,};
const unsigned char Lasercjl[] = { 0x42, 0x4d, 0x8a, 0x00, 0x00, 0x00, 0x00, 0x00, 0x00, 0x00, 0x76, 0x00, 0x00,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 0x00, 0xFF};
const unsigned char digitbmp[10][0x8b] = {
	{ 0x42, 0x4d, 0x8a, 0x00, 0x00, 0x00, 0x00, 0x00, 0x00, 0x00, 0x76, 0x00, 0x00,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 0x00, 0xFF},
	{ 0x42, 0x4d, 0x8a, 0x00, 0x00, 0x00, 0x00, 0x00, 0x00, 0x00, 0x76, 0x00, 0x00,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 0x00, 0xFF},
	{ 0x42, 0x4d, 0x8a, 0x00, 0x00, 0x00, 0x00, 0x00, 0x00, 0x00, 0x76, 0x00, 0x00,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 0x00, 0xFF},
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	{ 0x42, 0x4d, 0x8a, 0x00, 0x00, 0x00, 0x00, 0x00, 0x00, 0x00, 0x76, 0x00, 0x00,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 0x00, 0xFF},
};


extern char Screen[SCREENW*SCREENH/8];

void myNokia5110_PrintBMP(unsigned char xpos, unsigned char ypos, const unsigned char *ptr, unsigned char threshold);

/*********************************** SOUND ******************************************/

// DAC configuration
#define DAC_STEPS 16L
#define GPIO_PORTB (1L<<1)
#define DAC_PORT (GPIO_PORTB)
#define DAC_PINS (BIT(0)|BIT(1)|BIT(2)|BIT(3))
#define DAC_PCTL_PINS (PCTL(0)|PCTL(1)|PCTL(2)|PCTL(3))

/* my sounds - original 11KHz wav file data downsampled to 5.5k and compressed to one nibble per 4-bit dac step */
typedef enum Sound {
	EXPLOSION_SOUND=0,
	INVADER_SOUND=1,
	INVADER_KILLED_SOUND=2,
	SHOOT_SOUND=3,
	MOTHERSHIP_SOUND=4,
	MAX_SOUND
} Sound;

const unsigned char WAV55shoot[] =         {0x78, 0xa4, 0xa4, 0xb6, 0x78, 0x6a, 0x4a, 0x76, 0x95, 0xa5, 0x94, 0xa6, 0xaa,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 0x78,
0x88, 0x88, 0x78, 0x9a, 0x53, 0x67, 0x88, 0x88, 0x88, 0x78, 0xa9, 0x54,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 0x78, 0x77};
const unsigned char WAV55explosion[] =     {0x77, 0x78, 0x87, 0x77, 0x88, 0x65, 0x68, 0x87, 0x56, 0x77, 0x89, 0xaa, 0x97,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 0xf9,
0x20, 0x04, 0xdf, 0xc7, 0x30, 0x00, 0x06, 0xdb, 0xcf, 0xda, 0x72, 0x21,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 0xba
, 0x85, 0x45, 0x89, 0x86, 0x56, 0x63, 0x26, 0x9a, 0xbc, 0xb9, 0x74, 0x34,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 0x77,
0x88, 0x87, 0x78, 0x88, 0x78, 0x88, 0x77, 0x78, 0x77, 0x77, 0x77, 0x77,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 0x87, 0x88};
const unsigned char WAV55fastinvader[] =   {0x88, 0x88, 0x88, 0x88, 0x88, 0x88, 0x75, 0x20, 0x13, 0x58, 0xad, 0xef, 0xff,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 0x77, 0x66};
const unsigned char WAV55invaderkilled[] = {0x88, 0x88, 0x88, 0x88, 0x88, 0x88, 0x88, 0x88, 0x88, 0x88, 0x88, 0x88, 0x88,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 0x59,
0x5a, 0x69, 0x67, 0x86, 0x95, 0xa5, 0xa5, 0x96, 0x7a, 0x5a, 0x59, 0x77,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 0x87, 0x97};
const unsigned char WAV55ufo_highpitch[] = {0x86, 0x13, 0x8a, 0xcd, 0x85, 0x13, 0x8a, 0xdc, 0x74, 0x14, 0x9a, 0xeb, 0x63,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 0x9a, 0x88};

int sound_enabled[MAX_SOUND]={0};
unsigned long DAC_step[MAX_SOUND] =	{0};  // current Dac step
unsigned long DAC_max[MAX_SOUND] = {      // maximum Dac_step
	sizeof(WAV55explosion)/sizeof(WAV55explosion[0]),
	sizeof(WAV55fastinvader)/sizeof(WAV55fastinvader[0]),
	sizeof(WAV55invaderkilled)/sizeof(WAV55invaderkilled[0]),
	sizeof(WAV55shoot)/sizeof(WAV55shoot[0]),
	sizeof(WAV55ufo_highpitch)/sizeof(WAV55ufo_highpitch[0])};
const unsigned char *DAC_wav[] = {	WAV55explosion, WAV55fastinvader, WAV55invaderkilled, WAV55shoot, WAV55ufo_highpitch };

// Sound functions
void DAC_Init(void);
void DAC_Out(unsigned long data);
void Sound_Init(void);
void Sound_Tone(enum Sound sound);
void Sound_Off(int sound);
void SysTick_Handler(void);

/********************************** CONTROLS ******************************************/

long ADCdata;

unsigned long TimerCount2A;
unsigned long Semaphore2A;

// Control functions
void ADC0_Init(void);
unsigned long ADC0_In(void);
void Button_Init(void);
void LED_Init(void);
void LED1(int);
void LED2(int);
void Timer2_Init(unsigned long period);
void Timer2A_Handler(void);

/*************************** CODE *****************************/

/* Initialisation of constant global sprite values */
void init_sprites(void){
	int i,j;
	int n=0; // sprite_list index
	// Lives display
	hearts.height = Heart0cjl[BMP_HEIGHT];
	hearts.width = Heart0cjl[BMP_WIDTH];
	hearts.x_pos = SCREENW-hearts.width-1;
	hearts.y_pos = hearts.height;
	hearts.bitmap[0] = Heart0cjl;
	hearts.bitmap[1] = Heart1cjl;
	hearts.bitmap[2] = Heart2cjl;
	hearts.bitmap[3] = Heart3cjl;
	hearts.bitmapn = 0;
	hearts.exists = TRUE;
	sprite_list[n++] = &hearts;
	// Score display
	for (i=0; i<MAX_SCORE_DIGITS; i++)
	{
		score_digits[i].height = digitbmp[0][BMP_HEIGHT];
		score_digits[i].width = digitbmp[0][BMP_WIDTH];
		score_digits[i].x_pos = (MAX_SCORE_DIGITS-i-1)*score_digits[i].width;
		score_digits[i].y_pos = score_digits[i].height;
		score_digits[i].bitmap[0] = digitbmp[0];
		score_digits[i].bitmapn = 0;
		score_digits[i].exists = FALSE;
		sprite_list[n++] = &score_digits[i];
	}
	score_digits[0].exists = TRUE;
	// Missiles
	for (i=0; i<PMISSILES; i++)
	{
		player_missiles[i].height = Lasercjl[BMP_HEIGHT];
		player_missiles[i].width = Lasercjl[BMP_WIDTH];
		player_missiles[i].bitmap[0] = Lasercjl;
		player_missiles[i].bitmap[1] = Lasercjl;
		player_missiles[i].bitmap[2] = Lasercjl;
		player_missiles[i].bitmap[3] = Lasercjl;
		player_missiles[i].bitmapn = 0;
		player_missiles[i].exploding_at = 0xFF;
		sprite_list[n++] = &player_missiles[i];
	}
	for (i=0; i<AMISSILES; i++)
	{
		alien_missiles[i].height = Missile0cjl[BMP_HEIGHT];
		alien_missiles[i].width = Missile0cjl[BMP_WIDTH];
		alien_missiles[i].bitmap[0] = Missile0cjl;
		alien_missiles[i].bitmap[1] = Missile1cjl;
		alien_missiles[i].bitmap[2] = Missile0cjl;
		alien_missiles[i].bitmap[3] = Missile1cjl;
		alien_missiles[i].bitmapn = 0;
		alien_missiles[i].exploding_at = 0xFF;
		sprite_list[n++] = &alien_missiles[i];
	}
	// Players ship
	player.height = PlayerShip0cjl[BMP_HEIGHT];
	player.width = PlayerShip0cjl[BMP_WIDTH];
	player.x_pos = (SCREENW-player.width)/2-1;
	player.y_pos = SCREENH-1;
	player.bitmap[0] = PlayerShip0cjl;
	player.bitmap[1] = PlayerExplosion0cjl;
	player.bitmap[2] = PlayerExplosion1cjl;
	player.bitmap[3] = PlayerExplosion0cjl;
	player.bitmapn=0;
	player.exploding_at = 1;
	sprite_list[n++] = &player;
  // Players bunkers
	for (i=0; i<BUNKERS; i++)
	{
		bunkers[i].height = Bunker0[BMP_HEIGHT];
		bunkers[i].width = Bunker0[BMP_WIDTH];
		bunkers[i].x_pos = (SCREENW/BUNKERS - bunkers[i].width + i*SCREENW)/2;
		bunkers[i].y_pos = SCREENH-player.height-1;
		bunkers[i].bitmap[0] = Bunker0;
		bunkers[i].bitmap[1] = Bunker1;
		bunkers[i].bitmap[2] = Bunker2;
		bunkers[i].bitmap[3] = Bunker2;
		bunkers[i].bitmapn = 0;
		bunkers[i].exploding_at = 0xFF;
		sprite_list[n++] = &bunkers[i];
	}
	// Power bar display (overlaid on player ship)
	powerbar.height = player.height;
	powerbar.width = player.width;
	powerbar.x_pos = player.x_pos;
	powerbar.y_pos = player.y_pos;
	powerbar.bitmap[0] = powerbar1cjl;
	powerbar.bitmap[1] = powerbar2cjl;
	powerbar.bitmap[2] = powerbar3cjl;
	powerbar.bitmap[3] = powerbar4cjl;
	powerbar.bitmapn = power_level-1;
	powerbar.exists = TRUE;
	sprite_list[n++] = &powerbar;
	// Aliens
  mothership.height = SmallEnemyBonuscjl[BMP_HEIGHT];
	mothership.width = SmallEnemyBonuscjl[BMP_WIDTH];
	mothership.bitmap[0] = SmallEnemyBonuscjl;
	mothership.bitmap[1] = SmallExplosion0cjl;
	mothership.bitmap[2] = SmallExplosion0cjl;
	mothership.bitmap[3] = SmallExplosion0cjl;
	mothership.bitmapn = 0;
	mothership.exploding_at = 1;
	mothership.score = 100;
	sprite_list[n++] = &mothership;
	for (i=0; i<ALIEN_COLS; i++)
		for (j=0; j<ALIEN_ROWS; j++)
		{
			const unsigned char *bmpA[ALIEN_ROWS]={SmallEnemy30pointAcjl,SmallEnemy20pointAcjl,SmallEnemy10pointAcjl};
			const unsigned char *bmpB[ALIEN_ROWS]={SmallEnemy30pointBcjl,SmallEnemy20pointBcjl,SmallEnemy10pointBcjl};
			const int score[ALIEN_ROWS]={30,20,10};
			aliens[i][j].height = bmpA[j][BMP_HEIGHT]; // assumes bmpA and bmpB are equal width
	    aliens[i][j].width = bmpA[j][BMP_WIDTH];  // ditto
	    aliens[i][j].bitmap[0] = bmpA[j];
		  aliens[i][j].bitmap[1] = bmpB[j];
		  aliens[i][j].bitmap[2] = SmallExplosion0cjl;
		  aliens[i][j].bitmap[3] = SmallExplosion0cjl;
		  aliens[i][j].bitmapn = 0;
		  aliens[i][j].exploding_at = 2;
			aliens[i][j].score = score[j];
			sprite_list[n++] = &aliens[i][j];
  }
}

/* display the level at start of level */
void show_level(void){
	Nokia5110_ClearBuffer();
	Nokia5110_DisplayBuffer();
	Nokia5110_SetCursor(5,2);
	Nokia5110_OutUDec(level);
	Nokia5110_SetCursor(2,2);
	Nokia5110_OutString("Level");
	Delay100ms(25); // delay 2.5 seconds
}
/* return number of active aliens */
int count_aliens(void){
	int i,j;
	int count = mothership.exists;
	for (i=0; i<ALIEN_COLS; i++)
		for (j=0; j<ALIEN_ROWS; j++)
			if (aliens[i][j].exists && aliens[i][j].bitmapn<aliens[i][j].exploding_at)
				count ++;
	return count;
}

/* return number of active alien missiles */
int count_alien_missiles(void){
	int i;
	int count = 0;
	for (i=0; i<AMISSILES; i++)
		count += alien_missiles[i].exists;
	return count;
}

/* return number of active player missiles */
int count_player_missiles(void){
	int i;
	int count = 0;
	for (i=0; i<PMISSILES; i++)
		count += player_missiles[i].exists;
	return count;
}

/* start a player explosion sequence */
void explode_player(void){
	player.bitmapn=player.exploding_at;
	hearts.bitmapn = 4-lives;
	Sound_Tone(EXPLOSION_SOUND);
}

/* update the on-screen score digit sprites */
void update_score(int value){
	int i=0;
	int number;
	score += value;
	number = score;
	while (number > 0 && i < MAX_SCORE_DIGITS)
	{
		score_digits[i].exists = TRUE;
		score_digits[i++].bitmap[0] = digitbmp[number%10];
		number /= 10;
	}
}
/* start the destruction of an alien ship */
void explode_alien(Sprite* alien){
	int alien_count = count_aliens() - mothership.exists;
	alien->bitmapn=alien->exploding_at;
	update_score(alien->score);
	Sound_Tone(INVADER_KILLED_SOUND);
	if (alien != &mothership)
	{
		switch (alien_count - 1)
		{
			case 1:
			case 2:
				AlienSpeed = AlienSpeed/2+1;
				break;
			case ALIEN_COLS*ALIEN_ROWS*1/3:
			case ALIEN_COLS*ALIEN_ROWS*1/2:
			case ALIEN_COLS*ALIEN_ROWS*3/4:
				if (AlienSpeed>2) AlienSpeed--;
				break;
			default:
				break;
		}
	}
}

/* reset board to start of level state */
void reset_board(void){
	int i,j;
  // Reset player
	for (i=0; i<BUNKERS; i++)
	{
		bunkers[i].exists = TRUE;
	}
	// Reset alien positions
	destroy(&mothership);
	alien_direction = LEFT;
	AlienSpeed = AlienInitialSpeed;
	for (i=0; i<ALIEN_COLS; i++)
	{
		int y_pos = 0;
		for (j=0; j<ALIEN_ROWS; j++)
		{
			y_pos += aliens[i][j].height;
			aliens[i][j].exists = TRUE;
			aliens[i][j].x_pos = i*(aliens[i][j].width+1)+SCREENW-(ALIEN_COLS*(aliens[i][j].width+1))-1;
			aliens[i][j].y_pos = y_pos++;
		}
	}
	// clear any missiles
	for (i=0; i<PMISSILES; i++)
		destroy(&player_missiles[i]);
	for (i=0; i<AMISSILES; i++)
		destroy(&alien_missiles[i]);
}

/* check if any aliens are present on screen */
int aliens_exist (void){
	int i,j;
	if (mothership.exists) return TRUE;
	for (i=0; i<ALIEN_COLS; i++)
		for (j=0; j<ALIEN_ROWS; j++)
			if (aliens[i][j].exists) return TRUE;
	return FALSE;
}

/* update bunker damaged state */
void damage_bunker (Sprite *bunker){
	if (bunker->exists)
	{
		if (bunker->bitmapn < 2)
			bunker->bitmapn++;
		else
			destroy(bunker);
	}
}

/* change alien direction at end of a row */
void change_alien_direction(int direction){
	int i,j;
	int max_y=0;
	alien_direction = direction;
	for (i=0; i<ALIEN_COLS;i++)
		for (j=0; j<ALIEN_ROWS; j++)
		{
			if (aliens[i][j].exists && aliens[i][j].bitmapn<aliens[i][j].exploding_at)
			{
				aliens[i][j].y_pos += DOWN;
				if (aliens[i][j].y_pos > max_y)
					max_y = aliens[i][j].y_pos;
			}
		}
	if (max_y >= bunkers[0].y_pos-bunkers[0].height)
	{
		for (i=0; i< BUNKERS; i++)
			damage_bunker(&bunkers[i]);
	}
	if (max_y > player.y_pos-player.height)
	{
		explode_player();
		// move aliens to top row again
		destroy(&mothership);
		for (i=0; i<ALIEN_COLS; i++)
		{
			int y_pos = 0;
			for (j=0; j<ALIEN_ROWS; j++)
			{
				y_pos += aliens[i][j].height;
				aliens[i][j].x_pos = i*(aliens[i][j].width+1)+SCREENW-(ALIEN_COLS*(aliens[i][j].width+1))-1;
				aliens[i][j].y_pos = y_pos++;
			}
		}
	}
}

/* create any alien missiles randomly */
void create_alien_missiles(void){
	int i,j;
	// random value, reduced by number of aliens present, reduced by number of alien missiles already spawned
	int threshold = RAND_MAX-RAND_BASE_REDUCTION-count_aliens()*RAND_ALIEN_WEIGHT-count_alien_missiles()*RAND_MISSILE_WEIGHT;
	for (i=0; i<ALIEN_COLS; i++)
	{
		for (j=ALIEN_ROWS-1; j>=0; j--)
		{
			if (aliens[i][j].exists)
			{
				if (aliens[i][j].bitmapn < 2)
				{
					if ((int)Random() <= threshold)
					{
						int k=0;
						while (alien_missiles[k].exists) k++;
						alien_missiles[k].x_pos = aliens[i][j].x_pos+(aliens[i][j].width-alien_missiles[k].width)/2;
						alien_missiles[k].y_pos = aliens[i][j].y_pos;
						alien_missiles[k].exists = TRUE;
					}
				}
				break;
			}
		}
		if (count_alien_missiles() == AMISSILES) break;
	}
}

/* update mothership position */
void move_mothership(void){
	if (mothership.exists)
	{
		if (mothership.x_pos == SCREENW-mothership.width-1)
			destroy(&mothership);
		else if (mothership.bitmapn == 1)
			mothership.bitmapn = 2;
		else if (mothership.bitmapn == 2)
			mothership.bitmapn = 3;
		else if (mothership.bitmapn == 3)
			destroy(&mothership);
		else
			mothership.x_pos += RIGHT;
	// if no other noise is playing use the mothership sound
		Sound_Tone(MOTHERSHIP_SOUND);
	}
	else
	{
		int i,j;
		int min_y=47;
		// find topmost alien
		for (i=0; i<ALIEN_COLS; i++)
			for (j=0; j<ALIEN_ROWS; j++)
				if (aliens[i][j].exists)
					if (aliens[i][j].y_pos < min_y)
						min_y = aliens[i][j].y_pos - aliens[i][j].height;
		// If there is room for a mothership above the topmost alien
		if (min_y >= mothership.height)
		{ // Then there is a 3% chance each tick
			if (Random()<(RAND_MAX/32))
			{ // to spawn a mothership
				mothership.exists = TRUE;
				mothership.x_pos = 0;
				mothership.y_pos = mothership.height;
			}
		}
	}
}

/* update alien positions */
void move_aliens(void){
	/*
   For each living alien,
		1. move it to it's new position
				- detect end of row, reverse direction and drop down
		2. change the animation, progress alien explosions and delete exploded aliens
		3. possibly fire an alien missile
  */
	int i,j,start,end,step;
	if (alien_direction == LEFT)
	{
		start = 0;
		end = ALIEN_COLS;
		step = 1;
	}
	else
	{
		start = ALIEN_COLS-1;
		end = -1;
		step = -1;
	}
	for (i=start; i!=end; i+=step)
	{
		for (j=0; j<ALIEN_ROWS; j++)
		{
			if (aliens[i][j].exists)
			{
				if (alien_direction == LEFT && aliens[i][j].x_pos == 0)
					change_alien_direction(RIGHT);
				if (alien_direction == RIGHT && aliens[i][j].x_pos == SCREENW-aliens[i][j].width-1)
					change_alien_direction(LEFT);
				switch (aliens[i][j].bitmapn)
				{
					case 0: aliens[i][j].bitmapn=1; break;
					case 1: aliens[i][j].bitmapn=0; break;
					case 2: aliens[i][j].bitmapn=3; break;
					case 3: destroy(&aliens[i][j]); break;
					default: break; // Should never get here!!
				}
				aliens[i][j].x_pos += alien_direction;
			}
		}
	}
	create_alien_missiles();
	// Play the default invader noise
	Sound_Tone(INVADER_SOUND);
}

/* Create a player-initiated laser missile */
void create_player_missile(void){
		int missiles = count_player_missiles();
		if (missiles < PMISSILES)
		{
			int k,free;
			int max_y = 0;
			for (k=0; k<PMISSILES; k++)
			{
				if (player_missiles[k].exists)
				{
					if (player_missiles[k].y_pos > max_y)
						max_y = player_missiles[k].y_pos;
				}
				else
					free = k;
			}
			if ((max_y < SCREENH-player.height-player_missiles[free].height-1) ||
					(power_up && max_y < SCREENH-player.height-player_missiles[free].height+1))
			{
				player_missiles[free].x_pos = player.x_pos+(player.width-player_missiles[free].width)/2+1;
				player_missiles[free].y_pos = player.y_pos-player.height+player_missiles[free].height-1;
				player_missiles[free].exists = TRUE;
				Sound_Tone(SHOOT_SOUND);
				LED2(TRUE);
			}
		}
}
/* handle player and embedded powerbar sprite update and laser and auto-fire */
void move_player(void){
	// Read ADC value
	static int last_fire_button=0;
	int x_pos=ADCdata-(player.width>>1);
	if (player.bitmapn==player.exploding_at)
		player.bitmapn=2;
	if (player.bitmapn==2 && !(TimerCount2A%32))
		player.bitmapn=3;
	if (player.bitmapn==3 && !(TimerCount2A%32))
	{
		destroy(&player);
		destroy(&powerbar);
	}
	else
	{
	// Convert to screen position
		if (x_pos < 0)
			x_pos = 0;
		else if (x_pos > (SCREENW-player.width))
			x_pos = (SCREENW-player.width);
		player.x_pos = x_pos;
		if ((GPIO_PORTE_DATA_R & BIT(1)) || power_up )
		{
			if (power_level==MAX_POWER)
				power_up = TRUE;
			if (power_up)
			create_player_missile();
		}
		// Read fire button and compare with last time
		else if (GPIO_PORTE_DATA_R & BIT(0))
		{
			if (!last_fire_button)
			{
				// create missile
				create_player_missile();
				last_fire_button = TRUE;
			}
		}
		else
			last_fire_button = FALSE;
	}
	// update embedded power bar
	powerbar.x_pos = player.x_pos;
	// power bar is incremented every 2048th tick while power up is charging ~40 seconds to charge
	if (!power_up && !(TimerCount2A & 0x3FF))
	{
		if (power_level<MAX_POWER) power_level++;
		powerbar.bitmapn = power_level-1;
		powerbar.exists = TRUE;
	}
	// power bar is decremented every 256th tick while power up is active ~4 seconds active
	if (power_up && !(TimerCount2A & 0x3F))
	{
		if (power_level>0)
			power_level--;
		else
			power_up = FALSE;
		powerbar.bitmapn = power_level-1;
		powerbar.exists = (power_level>0);
	}
}
/* Detect whether two sprites overlap */
int sprite_collision(Sprite *s1, Sprite *s2){
	if ((s1->x_pos < s2->x_pos + s2->width) &&
			(s1->x_pos + s1->width > s2->x_pos) &&
			(s1->y_pos > s2->y_pos - s2->height) &&
			(s1->y_pos - s1->height < s2->y_pos))
		return TRUE;
	return FALSE;
}
/* Turn off a sprite */
void destroy(Sprite *s){
	s->exists=0;
	s->bitmapn=0;
}
/* Test whether the player has been hit by an alien missile */
void check_player_hit(Sprite *missile){
	if (player.bitmapn < player.exploding_at)
		if (sprite_collision(missile,&player))
		{
			explode_player();
			destroy(missile);
		}
}
/* Test whether an alien has been hit by a player missile */
void check_alien_hit(Sprite *missile){
	int i,j;
	for (i=0; i<ALIEN_COLS; i++)
		for (j=0; j<ALIEN_ROWS; j++)
			if (aliens[i][j].exists && (aliens[i][j].bitmapn < aliens[i][j].exploding_at))
				if (sprite_collision(missile,&aliens[i][j]))
				{
					explode_alien(&aliens[i][j]);
					destroy(missile);
					return;
				}
	if(mothership.exists && (mothership.bitmapn < mothership.exploding_at))
		if (sprite_collision(missile,&mothership))
		{
			explode_alien(&mothership);
			destroy(missile);
		}
}
/* Test whether a bunker has been hit by an alien missile */
void check_bunker_hit(Sprite *missile){
	int i;
	for (i=0; i<BUNKERS; i++)
		if (bunkers[i].exists)
			if (sprite_collision(missile,&bunkers[i]))
			{
				damage_bunker(&bunkers[i]);
				destroy(missile);
				return;
			}
}
/* Test whether a player missile has been hit by an alien missile */
void check_missile_collision(Sprite *missile){
	int i;
	for (i=0; i<AMISSILES; i++)
		if (alien_missiles[i].exists)
			if (sprite_collision(missile,&alien_missiles[i]))
			{
				destroy(missile);
				destroy(&alien_missiles[i]);
				return;
			}
}
/* update active player missiles */
void move_player_missiles(void){
	int i;
	for (i=0; i<PMISSILES; i++)
	{
		// move player missile
		if (player_missiles[i].exists)
		{
			// detect player missile collision with aliens/bunkers
			check_bunker_hit(&player_missiles[i]);
			check_missile_collision(&player_missiles[i]);
			check_alien_hit(&player_missiles[i]);
			if (player_missiles[i].y_pos == player_missiles[i].height)
				destroy(&player_missiles[i]);
			else
			{
				player_missiles[i].y_pos += UP;
				player_missiles[i].bitmapn = 1-player_missiles[i].bitmapn;
			}
		}
	}
}
/* update active alien missiles */
void move_alien_missiles(void){
	int i;
	// move alien missiles
	for (i=0; i<AMISSILES; i++)
	{
		if (alien_missiles[i].exists)
		{
			if (alien_missiles[i].y_pos == SCREENH-2)
				destroy(&alien_missiles[i]);
			else
			{
				alien_missiles[i].y_pos += DOWN;
				alien_missiles[i].bitmapn = 1-alien_missiles[i].bitmapn;
			}
		}
	// detect alien missile collision with player/bunkers
		if (alien_missiles[i].exists)
		{
			check_bunker_hit(&alien_missiles[i]);
			check_player_hit(&alien_missiles[i]);
			// no need to check missile collisions as player missile will check this and is updated faster
		}
	}
}
/* Update sprites at appropriate intervals */
void move_sprites(void){
	// player position is updated every tick
	move_player();
	// player missiles are updated every 3rd tick
	if (!(TimerCount2A % 2))
		move_player_missiles();
	// alien positions are updated every ? tick
	if (!(TimerCount2A % AlienSpeed))
		move_aliens();
	// mothership is updated every 8th tick
	if (!(TimerCount2A % 4))
		move_mothership();
	// enemy missiles are updated every 8th tick
	if (!(TimerCount2A % 6))
		move_alien_missiles();
}
/* Output a bitmap to the screen buffer */
void myNokia5110_PrintBMP(unsigned char xpos, unsigned char ypos, const unsigned char *ptr, unsigned char threshold){
  long width = ptr[BMP_WIDTH], height = ptr[BMP_HEIGHT], i, j;
  unsigned short screenx, screeny;
  unsigned char mask;
  // check for clipping
  if((height <= 0) ||              // bitmap is unexpectedly encoded in top-to-bottom pixel order
     ((width%2) != 0) ||           // must be even number of columns
     ((xpos + width) > SCREENW) || // right side cut off
     (ypos < (height - 1)) ||      // top cut off
     (ypos > SCREENH))           { // bottom cut off
		 return;
  }
  if(threshold > 14){
    threshold = 14;             // only full 'on' turns pixel on
  }
  // bitmaps are encoded backwards, so start at the bottom left corner of the image
  screeny = ypos/8;
  screenx = xpos + SCREENW*screeny;
  mask = ypos%8;                // row 0 to 7
  mask = 0x01<<mask;            // now stores a mask 0x01 to 0x80
  j = ptr[10];                  // byte 10 contains the offset where image data can be found
  for(i=1; i<=(width*height/2); i=i+1){
    // the left pixel is in the upper 4 bits
    if(((ptr[j]>>4)&0xF) > threshold)
      Screen[screenx] |= mask;
    screenx = screenx + 1;
    // the right pixel is in the lower 4 bits
    if((ptr[j]&0xF) > threshold)
      Screen[screenx] |= mask;
    screenx = screenx + 1;
    j = j + 1;
    if((i%(width/2)) == 0){     // at the end of a row
      if(mask > 0x01){
        mask = mask>>1;
      } else{
        mask = 0x80;
        screeny = screeny - 1;
      }
      screenx = xpos + SCREENW*screeny;
      // bitmaps are 32-bit word aligned
      switch((width/2)%4){      // skip any padding
        case 0: j = j + 0; break;
        case 1: j = j + 3; break;
        case 2: j = j + 2; break;
        case 3: j = j + 1; break;
      }
    }
  }
}
/* Draw all active sprites */
void draw_board(void){
	int i;
	Nokia5110_ClearBuffer();
	for (i=0; i<nsprites; i++)
		if (sprite_list[i]->exists)
			myNokia5110_PrintBMP(	sprite_list[i]->x_pos,
													sprite_list[i]->y_pos,
													sprite_list[i]->bitmap[sprite_list[i]->bitmapn],
													0);
  Nokia5110_DisplayBuffer();     // draw buffer
}
/* Hardware, Game and Sprite Initialisation */
void init (void){
  TExaS_Init(SSI0_Real_Nokia5110_Scope);  // set system clock to 80 MHz
  Random_Init(1);
	DAC_Init();
	ADC0_Init();
	Sound_Init();
	Button_Init();
	LED_Init();
  Nokia5110_Init();
	score = 0;
	lives = 3;
	init_sprites();
	Timer2_Init(CLOCK_SPEED/60); // Create 60Hz interrupt
}
/* Display the GAME OVER screen */
void game_over(void){
	Nokia5110_Clear();
  Nokia5110_SetCursor(1, 1);
  Nokia5110_OutString("GAME OVER");
  Nokia5110_SetCursor(1, 2);
  Nokia5110_OutString("Nice try,");
  Nokia5110_SetCursor(1, 3);
  Nokia5110_OutString("Earthling!");
  Nokia5110_SetCursor(2, 4);
  Nokia5110_OutUDec(score);
}

/* Main program */
int main(void){
	int i;
	init();
	// Display Space Invaders title screen
	Nokia5110_PrintBMP(	0,SCREENH-1,Marqueecjl,0);
	Nokia5110_DisplayBuffer();
	Delay100ms(20); // delay 2 seconds
  // Initialise the game board
	reset_board();
	show_level();
	while (lives > 0)
	{
		player.exists = TRUE;
		powerbar.exists = TRUE;
		powerbar.bitmapn = power_level - 1;
		while (player.exists)
		{
			while (aliens_exist() && player.exists)
			{
				while (!Semaphore2A) WaitForInterrupt();
				Semaphore2A = FALSE;
				move_sprites();
				draw_board();
			}
			if (!player.exists)
			{
				Delay100ms(1); // delay 0.1 seconds
				// remove a life and any missiles
				for (i=0; i<AMISSILES; i++)
					destroy(&alien_missiles[i]);
				for (i=0; i<PMISSILES; i++)
					destroy(&player_missiles[i]);
				lives--;
			}
			else
			{
				// Speed up the aliens and re-initialise the game board
				if (--AlienInitialSpeed == 1) AlienInitialSpeed = 2;
				reset_board();
				level +=1;
				show_level();
			}
		}
	}
	Delay100ms(5); // delay 0.5 seconds
	game_over();
	while(1){}
}
/* Initialise Timer 2 used for main control loop*/
void Timer2_Init(unsigned long period){
  unsigned long volatile delay;
  SYSCTL_RCGCTIMER_R |= SYSCTL_RCGCTIMER_R2; // 0a) activate timer2
//  SYSCTL_RCGCTIMER_R |= SYSCTL_RCGCTIMER_R3; // 0b) activate timer3
  delay = SYSCTL_RCGCTIMER_R;
// configure timer 2A
  TimerCount2A = 0;
  Semaphore2A = 0;
  TIMER2_CTL_R = 0x00000000;              // 1a) disable timer2 during setup
  TIMER2_CFG_R = TIMER_CFG_32_BIT_TIMER;  // 2a) configure timer2 for 32-bit mode
	TIMER2_TAMR_R |= TIMER_TAMR_TAMR_PERIOD; // 3a) periodic count down is default but needed by simulator
  TIMER2_TAILR_R = period-1;              // 4a) timer2A reload value
  TIMER2_TAPR_R = 0;                      // 5a) timer2A bus clock resolution
  TIMER2_ICR_R |= TIMER_ICR_TATOCINT;     // 6a) clear timer2A timeout flag
  TIMER2_IMR_R |= TIMER_IMR_TATOIM;       // 7a) arm timer2A timeout interrupt
	TIMER2_CTL_R |= TIMER_CTL_TAEN;         // 10a) enable timer2A
// interrupts are enabled in the main program after all devices initialized
// vector number 39, interrupt number 23
  NVIC_PRI5_R =                           // 8) priority 4
			(NVIC_PRI5_R & (~NVIC_PRI5_INT23_M))
			| (4UL << NVIC_PRI5_INT23_S);
  NVIC_EN0_R = 1<<23;                     // 9) enable IRQ 23 in NVIC
}
/* Update player position ADC data and enable main loop to run */
void Timer2A_Handler(void){
  TIMER2_ICR_R = TIMER_ICR_TATOCINT;   // acknowledge timer2A timeout
  TimerCount2A++;
  Semaphore2A = 1; // trigger
//  ADCdata = (((long)ADC0_In()-515L)*28L)>>10;    // 3 - collect an ADC sample of player x pos
	ADCdata = 66 - ADC0_In() * (SCREENW - BMP_WIDTH) / 4095;
}
/* General purpose 100ms delay */
void Delay100ms(unsigned long count){unsigned long volatile time;
  while(count>0){
    time = 727240;  // 0.1sec at 80 MHz
    while(time){
	  	time--;
    }
    count--;
  }
}
/* Initialise the player position ADC hardware */
void ADC0_Init(void){
// This initialization function sets up the ADC
// Max sample rate: <=125,000 samples/second
// SS3 triggering event: software trigger
// SS3 1st sample source:  channel 1
// SS3 interrupts: enabled but not promoted to controller
	volatile unsigned long delay;
	SYSCTL_RCGC2_R |= BIT(4);         // Enable GPIO Port E clock
	delay = SYSCTL_RCGC2_R;
	GPIO_PORTE_DIR_R &= ~(BIT(2));    // PE2 is input
	GPIO_PORTE_DEN_R &= ~(BIT(2));    // Disable digital input on PE2
	GPIO_PORTE_AFSEL_R |= BIT(2);     // Enable PE2 alternate function
	GPIO_PORTE_AMSEL_R |= BIT(2);     // Enable PE2 analog functions
	GPIO_PORTE_PCTL_R &= ~(PCTL(2));    // Clear PCTL content for PE2
  SYSCTL_RCGC0_R |= BIT(16);        // Enable ADC clock
	delay = SYSCTL_RCGC0_R;
	SYSCTL_RCGC0_R &= ~(SYSCTL_RCGC0_ADC0SPD_M); // Max Sample speed MAXADCSPD = 125 KHz
	SYSCTL_RCGC0_R |= SYSCTL_RCGC0_ADC0SPD_125K;
	ADC0_SSPRI_R = 0x3210L;           // SS3 is lowest priority
	ADC0_EMUX_R &= ~(0xF000L);        // EM3 is software triggered
	ADC0_SSCTL3_R = (BIT(1)|BIT(2));  // Interrupt enabled IE0=1, END0=1, TS0=0, D0=0
	ADC0_PSSI_R &= ~(BIT(3));         // Clear S/W request for SS3 sample
	ADC0_ACTSS_R |= BIT(3);           // Enable sequencer 3
	ADC0_SSMUX3_R = (ADC0_SSMUX3_R & ~(0xF)) | 1L;
	ADC0_ISC_R |= BIT(3);             // Clear SS3 ADC reading ready flag
}
/* Initialise the game buttons */
void Button_Init(void){
	/* Fire button is positive logic switch on PE0 */
	volatile unsigned long delay;
	SYSCTL_RCGC2_R |= SYSCTL_RCGC2_GPIOE; // Enable GPIO Port E clock
	delay = SYSCTL_RCGC2_R;
	// PE0 is fire button
	GPIO_PORTE_DIR_R &= ~(BIT(0));        // PE0 is input
	GPIO_PORTE_DEN_R |= BIT(0);           // Enable digital input on PE0
	GPIO_PORTE_PDR_R |= BIT(0);           // Enable pull-down resistor on PE0
	GPIO_PORTE_AFSEL_R &= BIT(0);         // Disable PE0 alternate function
	GPIO_PORTE_AMSEL_R &= BIT(0);         // Disable PE0 analog functions
	GPIO_PORTE_PCTL_R &= ~(PCTL(0));      // Clear PCTL content for PE0
	// PE1 is special weapon
	GPIO_PORTE_DIR_R &= ~(BIT(1));        // PE1 is input
	GPIO_PORTE_DEN_R |= BIT(1);           // Enable digital input on PE1
	GPIO_PORTE_PDR_R |= BIT(1);           // Enable pull-down resistor on PE1
	GPIO_PORTE_AFSEL_R &= BIT(1);         // Disable PE1 alternate function
	GPIO_PORTE_AMSEL_R &= BIT(1);         // Disable PE1 analog functions
	GPIO_PORTE_PCTL_R &= ~(PCTL(1));      // Clear PCTL content for PE1
}
/* Request and wait for an ADC sample */
unsigned long ADC0_In(void){
//------------ADC0_In------------
// Busy-wait Analog to digital conversion
// Input: none
// Output: 12-bit result of ADC conversion
	unsigned long ADC_value;
	ADC0_PSSI_R |= BIT(3);              // Request SS3 reading
	while (!(ADC0_RIS_R & BIT(3))){};   // wait for ADC sample capture
	ADC_value = ADC0_SSFIFO3_R & 0xFFF; // get sample
	ADC0_ISC_R |= BIT(3);               // Clear SS3 ADC reading ready flag
  return (ADC_value);
}
/* Initialise sound DAC */
void DAC_Init(void){
// **************DAC_Init*********************
// Initialize 4-bit DAC
// Input: none
// Output: none
	volatile unsigned long delay;
	SYSCTL_RCGC2_R |= GPIO_PORTB;
	delay = SYSCTL_RCGC2_R;
	GPIO_PORTB_AMSEL_R &= ~(DAC_PINS);
	GPIO_PORTB_AFSEL_R &= ~(DAC_PINS);
	GPIO_PORTB_DIR_R   |=   DAC_PINS;
	GPIO_PORTB_PCTL_R  &= ~(DAC_PCTL_PINS);
	GPIO_PORTB_DR8R_R  |=   DAC_PINS;
	GPIO_PORTB_DEN_R   |=   DAC_PINS;
}
/* Output a single sound DAC step */
void DAC_Out(unsigned long data){
// **************DAC_Out*********************
// output to DAC
// Input: 4-bit data, 0 to 15
// Output: none
	data = (data & (DAC_PINS)) | (GPIO_PORTB_DATA_R & ~(DAC_PINS));
  GPIO_PORTB_DATA_R = data;
}
/* Initialise the DAC hardware for 5.5 KHz wav sound playback */
void Sound_Init(void){
// **************Sound_Init*********************
// Initialize Systick periodic interrupts
// Also calls DAC_Init() to initialize DAC
// Input: none
// Output: none
  DAC_Init();
	NVIC_ST_CTRL_R = 0;
//	NVIC_ST_RELOAD_R = 7526; // 11 KHz sample rate
	NVIC_ST_RELOAD_R = 15052; // 5.5 KHz sample rate
	NVIC_ST_CURRENT_R = 0;
	NVIC_ST_CTRL_R = 7;
}
/* Turn LED1 on or off */
void LED1 (int on) {
	if (on)
		GPIO_PORTB_DATA_R |= BIT(4);
	else
		GPIO_PORTB_DATA_R &= ~(BIT(4));
}
/* Turn LED2 on or off */
void LED2 (int on) {
	if (on)
		GPIO_PORTB_DATA_R |= BIT(5);
	else
		GPIO_PORTB_DATA_R &= ~(BIT(5));
}
/* Start playing a sound */
void Sound_Tone(enum Sound sound){
// **************Sound_Tone*********************
// Change Systick periodic interrupts to start sound output
// Input: interrupt period
//           Units of period are 12.5ns
//           Maximum is 2^24-1
//           Minimum is determined by length of ISR
// Output: none
// this routine sets the RELOAD and starts SysTick
	sound_enabled[sound] = TRUE;
	if (sound == INVADER_SOUND)
		LED1(TRUE);
	else if (sound == SHOOT_SOUND)
		LED2(TRUE);
	DAC_step[sound] = 0;
}
/* Stop playing a sound */
void Sound_Off(int sound){
// **************Sound_Off*********************
// stop outputing to DAC
// Output: none
 // this routine stops the sound output
	sound_enabled[sound] = FALSE;
	if (sound == INVADER_SOUND)
		LED1(FALSE);
	else if (sound == SHOOT_SOUND)
		LED2(FALSE);
}
/* Initialise LED hardware */
void LED_Init(void){
	/* LEDs are on PB4 and PB5 */
	volatile unsigned long delay;
	SYSCTL_RCGC2_R |= SYSCTL_RCGC2_GPIOB; // Enable GPIO Port B clock
	delay = SYSCTL_RCGC2_R;
	GPIO_PORTB_DIR_R |=    (BIT(4)|BIT(5));    // PB4,5 are output
	GPIO_PORTB_AFSEL_R &= ~(BIT(4)|BIT(5));    // Disable alternate function
	GPIO_PORTB_AMSEL_R &= ~(BIT(4)|BIT(5));    // Disable analog functions
	GPIO_PORTB_PCTL_R &= ~(PCTL(4)|PCTL(5));   // Clear PCTL content
	GPIO_PORTB_DEN_R |=    (BIT(4)|BIT(5));    // Enable digital
}
/* Combine active sounds and pass to DAC hardware */
void SysTick_Handler(void){
// Interrupt service routine
// Executed at 11KHz
	int i;
	unsigned long DAC_acc=0;
	int num_sounds_active=0;
	for (i=0; i<MAX_SOUND; i++)
	{
		if (sound_enabled[i])
		{
			unsigned char DAC_val;
			num_sounds_active++;
			DAC_val = *(DAC_wav[i]+(DAC_step[i]/2));
			if (DAC_step[i]%2)
				DAC_acc += DAC_val&0xF;
			else
				DAC_acc += DAC_val>>4;
			if (DAC_step[i]/2 >= DAC_max[i])
				Sound_Off(i);
			DAC_step[i]++;
		}
		if (num_sounds_active > 0)
			DAC_Out(DAC_acc/num_sounds_active);
	}
}
